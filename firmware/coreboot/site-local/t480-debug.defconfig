## firmware/coreboot/site-local/t480-debug.defconfig
```kconfig
CONFIG_LOCALVERSION="t480"
CONFIG_VENDOR_LENOVO=y
CONFIG_BOARD_LENOVO_T480=y
CONFIG_HAVE_IFD_BIN=y
CONFIG_IFD_BIN_PATH="site-local/data/ifd.bin"
CONFIG_HAVE_ME_BIN=y
CONFIG_ME_BIN_PATH="site-local/data/me.bin"
CONFIG_HAVE_GBE_BIN=y
CONFIG_GBE_BIN_PATH="site-local/data/gbe.bin"
CONFIG_ADD_FSP_BINARIES=y
CONFIG_FSP_USE_REPO=y
CONFIG_MAINBOARD_USE_LIBGFXINIT=y
CONFIG_GENERIC_LINEAR_FRAMEBUFFER=y
# CONFIG_CONSOLE_SERIAL is not set
CONFIG_POWER_STATE_OFF_AFTER_FAILURE=y
CONFIG_PAYLOAD_GRUB2=y
CONFIG_GRUB2_REVISION=y
CONFIG_GRUB2_REVISION_ID="t480"
CONFIG_GRUB2_EXTRA_MODULES="nvme gfxterm_background png keystatus time boottime sleep cmostest"
CONFIG_GRUB2_INCLUDE_RUNTIME_CONFIG_FILE=y
CONFIG_GRUB2_RUNTIME_CONFIG_FILE="site-local/grub.cfg"
CONFIG_SEABIOS_SECONDARY_PAYLOAD=y
CONFIG_SEABIOS_BOOTORDER_FILE="site-local/data/bootorder"
CONFIG_SEABIOS_PS2_TIMEOUT=500
CONFIG_COREINFO_SECONDARY_PAYLOAD=y
CONFIG_MEMTEST_SECONDARY_PAYLOAD=y
CONFIG_TINT_SECONDARY_PAYLOAD=y
CONFIG_COREDOOM_SECONDARY_PAYLOAD=y
CONFIG_COREDOOM_WAD_FILE="site-local/data/doom.wad"
CONFIG_FSP_HYPERTHREADING=y
CONFIG_FMDFILE="site-local/t480-debug.fmd"
CONFIG_CONSOLE_SPI_FLASH=y
CONFIG_DEFAULT_CONSOLE_LOGLEVEL_7=y
```
